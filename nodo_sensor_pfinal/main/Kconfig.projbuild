## nodo_sensor_pfinal/main/Kconfig.projbuild
```kconfig
menu "Example Configuration"
	config ESP_WIFI_SSID
		string "WiFi SSID"
		default "david_"
	config ESP_WIFI_PASSWORD
		string "WiFi Password"
		default "david123"
	config BROKER_URL
		string "Broker URL"
		default "mqtt://192.168.137.156:1883"
endmenu
```

## nodo_visualizacion/main/Kconfig.projbuild
```kconfig
menu "Example Configuration"
	config ESP_WIFI_SSID
		string "WiFi SSID"
		default "MIWIFI_TJem"
	config ESP_WIFI_PASSWORD
		string "WiFi Password"
		default "dMrHTu7X"
	config BROKER_URL
		string "Broker URL"
		default "mqtt://192.168.1.134:1883"
endmenu
```
